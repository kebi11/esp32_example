## components/app_config/Kconfig.projbuild
```kconfig
menu "Application Configuration"

    config APP_DEVICE_NAME
        string "Device name"
        default "esp32s3-gnss-01"
        help
            Device name reported by /api/status.

    config APP_WIFI_SSID
        string "Default Wi-Fi SSID"
        default ""
        help
            Compiled-in fallback SSID. Runtime value stored in NVS takes priority.
            Leave empty and provision via AP mode to avoid committing credentials.

    config APP_WIFI_PASSWORD
        string "Default Wi-Fi password"
        default ""
        help
            Compiled-in fallback password. Runtime value stored in NVS takes priority.

    config APP_WIFI_RETRY_MAX
        int "Wi-Fi connect retry limit"
        range 1 100
        default 10
        help
            Number of STA reconnect attempts before giving up (and falling back to AP).

    config APP_AP_SSID
        string "AP provisioning SSID"
        default "ESP32-GNSS-Setup"
        help
            SSID broadcast in AP mode when no credentials are available.

    config APP_WEB_SERVER_PORT
        int "HTTP server port"
        range 1 65535
        default 80

endmenu
```

## components/gnss/Kconfig.projbuild
```kconfig
menu "GNSS Configuration"

    config GNSS_UART_NUM
        int "GNSS UART port number"
        range 0 2
        default 1
        help
            UART peripheral used to talk to the GNSS module.

    config GNSS_UART_BAUDRATE
        int "GNSS UART baud rate"
        default 115200
        help
            Measured value for this S1216F8-BD unit: it outputs $GNRMC at
            20 Hz / 115200 8N1, not the 9600 datasheet default.

    config GNSS_UART_RX_GPIO
        int "GNSS UART RX GPIO"
        default 18
        help
            ESP32-S3 RX pin, connect to GNSS TXD.

    config GNSS_UART_TX_GPIO
        int "GNSS UART TX GPIO"
        default 17
        help
            ESP32-S3 TX pin, connect to GNSS RXD. Only needed when configuring the module.

    config GNSS_TASK_STACK_SIZE
        int "GNSS task stack size"
        range 2048 16384
        default 4096

    config GNSS_TASK_PRIORITY
        int "GNSS task priority"
        range 1 24
        default 5

endmenu
```

## sdkconfig.defaults
```kconfig
# 目标芯片
CONFIG_IDF_TARGET="esp32s3"

# FreeRTOS 节拍，1ms tick 便于 vTaskDelay(pdMS_TO_TICKS(x))
CONFIG_FREERTOS_HZ=1000

# 日志默认等级：Info
CONFIG_LOG_DEFAULT_LEVEL_INFO=y

# NVS / 分区
CONFIG_NVS_ENCRYPTION=n

# 任务看门狗（Phase 9 网络可靠性时使用）
CONFIG_ESP_TASK_WDT_EN=y
CONFIG_ESP_TASK_WDT_PANIC=n
```
